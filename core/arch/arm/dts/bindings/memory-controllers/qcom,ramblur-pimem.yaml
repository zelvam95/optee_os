## core/arch/arm/dts/bindings/memory-controllers/qcom,ramblur-pimem.yaml
```yaml
# SPDX-License-Identifier: (GPL-2.0-only OR BSD-2-Clause)
# Copyright (c) Qualcomm Technologies, Inc. and/or its subsidiaries.
%YAML 1.2
---
$id: http://devicetree.org/schemas/memory-controllers/qcom,ramblur-pimem.yaml#
$schema: http://devicetree.org/meta-schemas/core.yaml#

title: Qualcomm Ramblur pIMEM controller

maintainers:
  - Selvam Sathappan Periakaruppan <selvam.periakaruppan@oss.qualcomm.com>

description:
  Memory protection controller of the pIMEM. OP-TEE sets up one window with
  confidentiality, integrity and anti-rollback over the vault used as TA RAM.
  Only OP-TEE uses it, so the node is secure-only.

properties:
  compatible:
    const: qcom,ramblur-pimem

  reg:
    maxItems: 1

  memory-region:
    maxItems: 1
    description:
      Reserved-memory region of the vault, as large as the TA RAM.

required:
  - compatible
  - reg
  - memory-region

additionalProperties: false

examples:
  - |
    reserved-memory {
        #address-cells = <1>;
        #size-cells = <1>;
        ranges;

        trusted_apps_mem: trusted-apps@d1900000 {
            reg = <0xd1900000 0x1c00000>;
            no-map;
        };
    };

    pimem@610000 {
        compatible = "qcom,ramblur-pimem";
        reg = <0x610000 0x4000>;
        memory-region = <&trusted_apps_mem>;
        status = "disabled";
        secure-status = "okay";
    };
```
